#include "ssd1306.h"
#include <string.h>
#include <stdlib.h> // for abs()

#define SSD1306_I2C_ADDR   (0x3C << 1)
#define SSD1306_WIDTH      128
#define SSD1306_HEIGHT     64

static uint8_t ssd1306_buffer[SSD1306_WIDTH * SSD1306_HEIGHT / 8];
static I2C_HandleTypeDef *ssd1306_i2c;

static uint8_t cursor_x = 0;
static uint8_t cursor_y = 0;

// 5x7 font (each char 5 bytes, +1 blank column between chars)
static const uint8_t Font5x7[][5] = {
  // ASCII 32..126
  {0x00,0x00,0x00,0x00,0x00}, // ' '
  {0x00,0x00,0x5F,0x00,0x00}, // '!'
  {0x00,0x07,0x00,0x07,0x00}, // '"'
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  {0x08,0x08,0x2A,0x1C,0x08}, // '~'
};

static void ssd1306_WriteCommand(uint8_t cmd)
{
    uint8_t data[2];
    data[0] = 0x00;
    data[1] = cmd;
    HAL_I2C_Master_Transmit(ssd1306_i2c, SSD1306_I2C_ADDR, data, 2, 100);
}

void SSD1306_Init(I2C_HandleTypeDef *hi2c)
{
    ssd1306_i2c = hi2c;

    HAL_Delay(100);

    ssd1306_WriteCommand(0xAE);
    ssd1306_WriteCommand(0x20);
    ssd1306_WriteCommand(0x00);
    ssd1306_WriteCommand(0xB0);
    ssd1306_WriteCommand(0xC8);
    ssd1306_WriteCommand(0x00);
    ssd1306_WriteCommand(0x10);
    ssd1306_WriteCommand(0x40);
    ssd1306_WriteCommand(0x81);
    ssd1306_WriteCommand(0x7F);
    ssd1306_WriteCommand(0xA1);
    ssd1306_WriteCommand(0xA6);
    ssd1306_WriteCommand(0xA8);
    ssd1306_WriteCommand(0x3F);
    ssd1306_WriteCommand(0xA4);
    ssd1306_WriteCommand(0xD3);
    ssd1306_WriteCommand(0x00);
    ssd1306_WriteCommand(0xD5);
    ssd1306_WriteCommand(0x80);
    ssd1306_WriteCommand(0xD9);
    ssd1306_WriteCommand(0xF1);
    ssd1306_WriteCommand(0xDA);
    ssd1306_WriteCommand(0x12);
    ssd1306_WriteCommand(0xDB);
    ssd1306_WriteCommand(0x40);
    ssd1306_WriteCommand(0x8D);
    ssd1306_WriteCommand(0x14);
    ssd1306_WriteCommand(0xAF);

    SSD1306_Fill(0);
    SSD1306_Update();
}

void SSD1306_Fill(uint8_t color)
{
    memset(ssd1306_buffer, color ? 0xFF : 0x00, sizeof(ssd1306_buffer));
}

void SSD1306_Update(void)
{
    for (uint8_t page = 0; page < 8; page++)
    {
        ssd1306_WriteCommand(0xB0 + page);
        ssd1306_WriteCommand(0x00);
        ssd1306_WriteCommand(0x10);

        uint8_t data[1 + 128];
        data[0] = 0x40;
        memcpy(&data[1], &ssd1306_buffer[128 * page], 128);

        HAL_I2C_Master_Transmit(ssd1306_i2c, SSD1306_I2C_ADDR, data, 1 + 128, 100);
    }
}

void SSD1306_SetCursor(uint8_t x, uint8_t y)
{
    cursor_x = x;
    cursor_y = y;   // y should be multiple of 8 for this simple 5x7 font
}

void SSD1306_WriteChar(char c)
{
    if (c < 32 || c > 126) c = '?';

    const uint8_t *glyph = Font5x7[c - 32];
    uint16_t index = cursor_x + (cursor_y / 8) * 128;

    for (int i = 0; i < 5; i++)
    {
        if (cursor_x + i < 128)
            ssd1306_buffer[index + i] = glyph[i];
    }

    // one column space
    if (cursor_x + 5 < 128)
        ssd1306_buffer[index + 5] = 0x00;

    cursor_x += 6;
    if (cursor_x >= 128) cursor_x = 0;
}

void SSD1306_WriteString(const char *str)
{
    while (*str)
    {
        SSD1306_WriteChar(*str++);
    }
}

// ----------------------------------------------------
// New Graphics Primitives
// ----------------------------------------------------

void SSD1306_DrawPixel(int16_t x, int16_t y, uint8_t color)
{
    if (x < 0 || x >= SSD1306_WIDTH || y < 0 || y >= SSD1306_HEIGHT)
        return;

    // The buffer is organized in vertical bands of 8 pixels
    // x determines column
    // y / 8 determines page (row)
    // y % 8 determines bit in the byte
    if (color)
    {
        ssd1306_buffer[x + (y / 8) * SSD1306_WIDTH] |= (1 << (y % 8));
    }
    else
    {
        ssd1306_buffer[x + (y / 8) * SSD1306_WIDTH] &= ~(1 << (y % 8));
    }
}

// Bresenham's Line Algorithm
void SSD1306_DrawLine(int16_t x0, int16_t y0, int16_t x1, int16_t y1, uint8_t color)
{
    int16_t dx = abs(x1 - x0);
    int16_t dy = abs(y1 - y0);
    int16_t sx = (x0 < x1) ? 1 : -1;
    int16_t sy = (y0 < y1) ? 1 : -1;
    int16_t err = dx - dy;

    while (1)
    {
        SSD1306_DrawPixel(x0, y0, color);
        if (x0 == x1 && y0 == y1) break;
        int16_t e2 = 2 * err;
        if (e2 > -dy) { err -= dy; x0 += sx; }
        if (e2 < dx)  { err += dx; y0 += sy; }
    }
}
